// SPIKE usa e getta · fastink: disegno e carattere 5×7.
#include "canvas.h"
#include <string.h>

namespace fi {

// Carattere 5×7 classico, colonne con bit 0 in alto, ASCII 32..126
static const uint8_t kFont[95][5] = {
    {0x00, 0x00, 0x00, 0x00, 0x00}, {0x00, 0x00, 0x5F, 0x00, 0x00}, {0x00, 0x07, 0x00, 0x07, 0x00},
    {0x14, 0x7F, 0x14, 0x7F, 0x14}, {0x24, 0x2A, 0x7F, 0x2A, 0x12}, {0x23, 0x13, 0x08, 0x64, 0x62},
    {0x36, 0x49, 0x56, 0x20, 0x50}, {0x00, 0x08, 0x07, 0x03, 0x00}, {0x00, 0x1C, 0x22, 0x41, 0x00},
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    {0x00, 0x41, 0x36, 0x08, 0x00}, {0x08, 0x04, 0x08, 0x10, 0x08},
};

void Canvas::clear(bool white) {
  memset(buf, white ? 0xFF : 0x00, sizeof(buf));
  // colonne invisibili sempre bianche: il motore non le pilota mai
  if (!white)
    for (int y = 0; y < kRamH; y++) buf[y * kRowBytes + kVisW / 8] |= (uint8_t)(0xFF >> (kVisW & 7));
}

void Canvas::px(int x, int y, bool black) {
  if (x < 0 || x >= kScrW || y < 0 || y >= kScrH) return;
  uint8_t m;
  const int i = ramIndex(x, y, m);
  if (black) buf[i] &= (uint8_t)~m;
  else buf[i] |= m;
}

bool Canvas::isBlack(int x, int y) const {
  if (x < 0 || x >= kScrW || y < 0 || y >= kScrH) return false;
  uint8_t m;
  return !(buf[ramIndex(x, y, m)] & m);
}

void Canvas::rect(int x, int y, int w, int h, bool black) {
  for (int j = y; j < y + h; j++)
    for (int i = x; i < x + w; i++) px(i, j, black);
}

int Canvas::text(int x, int y, const char *s, int scale, bool black) {
  const int x0 = x;
  for (; *s; s++) {
    unsigned c = (unsigned char)*s;
    if (c < 32 || c > 126) c = '?';
    const uint8_t *g = kFont[c - 32];
    for (int col = 0; col < 5; col++)
      for (int row = 0; row < 8; row++)
        if (g[col] & (1 << row)) rect(x + col * scale, y + row * scale, scale, scale, black);
    x += 6 * scale;
  }
  return x - x0;
}

int Canvas::textWidth(const char *s, int scale) { return (int)strlen(s) * 6 * scale; }

}  // namespace fi
